## Kernel_5_10_52/Thor96_L5_10_52_Rel_4_1_patches/meta-einfochips-ap1302/conf/layer.conf
```bitbake
# We have a conf and classes directory, add to BBPATH
BBPATH .= ":${LAYERDIR}"

# We have recipes-* directories, add to BBFILES
BBFILES += "${LAYERDIR}/recipes-*/*/*.bb \
            ${LAYERDIR}/recipes-*/*/*.bbappend"

BBFILE_COLLECTIONS += "meta-einfochips-ap1302"
BBFILE_PATTERN_meta-einfochips-ap1302 = "^${LAYERDIR}/"
BBFILE_PRIORITY_meta-einfochips-ap1302 = "10"

LAYERDEPENDS_meta-einfochips-ap1302 = "core"
LAYERSERIES_COMPAT_meta-einfochips-ap1302 = "hardknott"
```
